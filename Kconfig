## Kconfig
```kconfig
#
# For a description of the syntax of this configuration file,
# see the file kconfig-language.txt in the NuttX tools repository.
#

config EXAMPLES_DEMO
	tristate "\"Demo, :World!\" example"
	default n
	---help---
		Enable the \"Demo, World!\" example

if EXAMPLES_DEMO

config EXAMPLES_DEMO_PROGNAME
	string "Program name"
	default "demo"
	---help---
		This is the name of the program that will be used when the NSH ELF
		program is installed.

config EXAMPLES_DEMO_PRIORITY
	int "Demo task priority"
	default 100

config EXAMPLES_DEMO_STACKSIZE
	int "Demo stack size"
	default DEFAULT_TASK_STACKSIZE

endif
```
